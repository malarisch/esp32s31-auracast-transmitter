## main/Kconfig.projbuild
```kconfig
menu "AES67 Auracast bridge"

    menu "I2S input (from FPGA)"
        config AURACAST_I2S_BCLK_GPIO
            int "BCLK GPIO (J2-19)"
            default 40
        config AURACAST_I2S_WS_GPIO
            int "WS GPIO (J2-20)"
            default 42
        config AURACAST_I2S_DIN_GPIO
            int "DATA GPIO (J2-21)"
            default 39
        config AURACAST_I2S_BCLK_DIV
            int "Slave sampling clock in multiples of BCLK"
            default 8
            range 8 32
            help
                The slave synchronises BCLK/WS/DATA to an internal clock of N x BCLK. With N = 8
                (24.576 MHz) the sampling point lands 80..120 ns after the BCLK edge and can hit
                the DATA transition, depending on the transmitter's output timing.
        config AURACAST_I2S_BCLK_INV
            bool "Sample DATA on the falling BCLK edge (invert BCLK input)"
            depends on !AURACAST_TEST_TONE
            default y
            help
                The FPGA changes DATA shortly after the rising BCLK edge. A DAC samples exactly on
                the edge and still sees the old bit, but the S31 slave samples 80..120 ns later
                (synchroniser, see bclk_div) and hits the transition: one bit early or random,
                heard as periodic clicks. Sampling on the falling edge is in the middle of the bit.
                Check: the "i2s bits=" log line must end in 00 for 24-bit data (80 = one bit early).
                Off in test-tone mode: the internal I2S1 master changes DATA on the falling edge.
    endmenu

    menu "I2C control (S31 = slave, protocol: components/ctrl_regs/include/auracast_i2c_regs.h)"
        config AURACAST_I2C_ADDR
            hex "7-bit slave address"
            default 0x3A
            range 0x08 0x77
        config AURACAST_I2C_SDA_GPIO
            int "SDA GPIO (J2-17)"
            default 43
        config AURACAST_I2C_SCL_GPIO
            int "SCL GPIO (J2-18)"
            default 44
        config AURACAST_AUTOSTART
            bool "Start broadcasting at boot with the power-on configuration (bench use without an I2C master)"
            default n
            help
                Normally the S31 waits after boot until the I2C master has written the configuration and
                sent START. With this option it starts at once with the power-on register values
                (AURA_DEFAULT_* in auracast_i2c_regs.h: 24_2_1 mono Live). The I2C slave still runs.
        config AURACAST_AUTOSTART_HQ_PRESET
            int "AUTOSTART: HQ subgroup preset (register 0x50)"
            depends on AURACAST_AUTOSTART
            range 2 255
            default 255
            help
                255 = no HQ subgroup; 2 48_2_1, 3 48_4_1, 4 48_6_1: a second subgroup at 48 kHz in the same
                BIG, next to the Standard Quality one.
        config AURACAST_AUTOSTART_CHANNELS
            int "AUTOSTART: channel mode of the first subgroup (register 0x11)"
            depends on AURACAST_AUTOSTART
            range 0 3
            default 0
            help
                0 mono (L+R)/2, 1 stereo (2 BIS), 2 mono left, 3 mono right.
        config AURACAST_AUTOSTART_HQ_CHANNELS
            int "AUTOSTART: channel mode of the HQ subgroup (register 0x51)"
            depends on AURACAST_AUTOSTART
            range 0 3
            default 1
            help
                0 mono (L+R)/2, 1 stereo (2 BIS), 2 mono left, 3 mono right.
    endmenu

    choice AURACAST_SOURCE
        prompt "Audio source"
        default AURACAST_SOURCE_I2S
        config AURACAST_SOURCE_I2S
            bool "I2S slave input (FPGA)"
        config AURACAST_SOURCE_SYNTH
            bool "Synthetic tones (440 Hz left, 880 Hz right), no I2S"
    endchoice

    menu "Test mode (no FPGA)"
        depends on AURACAST_SOURCE_I2S
        config AURACAST_TEST_TONE
            bool "Generate test tone on I2S1 and loop it back into the I2S input"
            default n
            help
                I2S1 drives BCLK/WS/DATA on the input pins as master (APLL clock).
                Do not connect the FPGA while this is enabled.
        config AURACAST_TEST_TONE_RATE_HZ
            int "Test tone sample rate (Hz), deliberately off 48000 to emulate drift"
            depends on AURACAST_TEST_TONE
            default 48002
        config AURACAST_TEST_TONE_START_DELAY_MS
            int "Delay before the test tone starts (ms)"
            depends on AURACAST_TEST_TONE
            default 0
        config AURACAST_TEST_TONE_GAP_TEST
            bool "Switch the test tone off for 2 s every 30 s"
            depends on AURACAST_TEST_TONE
            default n
    endmenu

    config AURACAST_DEBUG_SKIP_SEND_EVERY
        int "Debug: skip sending every Nth SDU pair (0 = off)"
        default 0

    config AURACAST_DEBUG_DROP_SENT_EVERY
        int "Debug: ignore every Nth completion callback of BIS 0 (0 = off)"
        default 0

endmenu
```
